## boards/shields/evo/Kconfig.defconfig
```kconfig
if SHIELD_EVO_LEFT

config ZMK_KEYBOARD_NAME
    default "Evo"

config ZMK_SPLIT_ROLE_CENTRAL
    default y
endif

if SHIELD_EVO_LEFT || SHIELD_EVO_RIGHT

config ZMK_SPLIT
    default y

endif
```

## boards/shields/evo/Kconfig.shield
```kconfig
config SHIELD_EVO_LEFT
    def_bool $(shields_list_contains,evo_left)

config SHIELD_EVO_RIGHT
    def_bool $(shields_list_contains,evo_right)
```

## boards/shields/imadam56/Kconfig.defconfig
```kconfig
# Copyright (c) 2020 Ryan Cross
# SPDX-License-Identifier: MIT

if SHIELD_IMADAM56_LEFT

config ZMK_KEYBOARD_NAME
    default "imadam56"

config ZMK_SPLIT_ROLE_CENTRAL
    default y

endif

if SHIELD_IMADAM56_LEFT || SHIELD_IMADAM56_RIGHT
config ZMK_SPLIT
    default y
endif
```

## boards/shields/imadam56/Kconfig.shield
```kconfig
# Copyright (c) 2020 Ryan Cross
# SPDX-License-Identifier: MIT

config SHIELD_IMADAM56_LEFT
    def_bool $(shields_list_contains,evo56_left)

config SHIELD_IMADAM56_RIGHT
    def_bool $(shields_list_contains,evo56_right)

config SHIELD_IMADAM56_DONGLE
    def_bool $(shields_list_contains,evo56_dongle)
```

## config/west.yml
```yaml
manifest:
  remotes:
    - name: zmkfirmware
      url-base: https://github.com/zmkfirmware
    - name: duckyb
      url-base: https://github.com/duckyb
    - name: m165437
      url-base: https://github.com/m165437
    # Additional modules containing boards/shields/custom code can be listed here as well
    # See https://docs.zephyrproject.org/3.2.0/develop/west/manifest.html#projects
  projects:
    - name: zmk
      remote: zmkfirmware
      revision: main
      import: app/west.yml
    - name: urchin-zmk-module
      remote: duckyb
      revision: main
    - name: nice-view-gem
      remote: m165437
      revision: main
  self:
    path: config
```
